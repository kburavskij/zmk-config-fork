## boards/shields/cradio_dongle/Kconfig.defconfig
```kconfig
if SHIELD_CRADIO_DONGLE

config ZMK_KEYBOARD_NAME
    default "Sweep"

config ZMK_SPLIT_ROLE_CENTRAL
    default y

config ZMK_USB
    default y

config BUILD_OUTPUT_HEX
    default y

config BUILD_OUTPUT_UF2
    default n


endif

if SHIELD_CRADIO_LEFT || SHIELD_CRADIO_RIGHT

config ZMK_SPLIT
    default y

config ZMK_BLE
    default y

config BUILD_OUTPUT_HEX
    default y

config BUILD_OUTPUT_UF2
    default n

endif

if SHIELD_DONGLE_SETTINGS_RESET

config ZMK_KEYBOARD_NAME
	default "SETTINGS RESET"
config ZMK_SPLIT_BLE_CENTRAL_PERIPHERALS
    default 2
config ZMK_SPLIT_ROLE_CENTRAL
    default y
config ZMK_SPLIT
    default y
config ZMK_SPLIT_BLE_CENTRAL_PERIPHERALS
    default 1  
config BT_MAX_CONN
    default 6  
config BT_MAX_PAIRED
    default 6  

endif
```
